## config/west.yml
```yaml
manifest:
  remotes:
    - name: pyg
      url-base: https://github.com/pyg
  projects:
    - name: zmk
      remote: pyg
      revision: caksoylar/zen-v2+mouse  # custom branch name
      import: app/west.yml
  self:
    path: config
```
